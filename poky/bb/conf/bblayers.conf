## poky/bb/conf/bblayers.conf
```bitbake
# LAYER_CONF_VERSION is increased each time build/conf/bblayers.conf
# changes incompatibly
LCONF_VERSION = "6"

BBPATH = "${TOPDIR}"
BBFILES ?= ""

BBLAYERS ?= " \
  /home/likewise-open/BEI/boerrs/private/beaglebone/poky/meta \
  /home/likewise-open/BEI/boerrs/private/beaglebone/poky/meta-yocto \
  /home/likewise-open/BEI/boerrs/private/beaglebone/poky/meta-yocto-bsp \
  /home/likewise-open/BEI/boerrs/private/beaglebone/poky/meta-ti \
  "
BBLAYERS_NON_REMOVABLE ?= " \
  /home/likewise-open/BEI/boerrs/private/beaglebone/poky/meta \
  /home/likewise-open/BEI/boerrs/private/beaglebone/poky/meta-yocto \
  "
```

## poky/meta-ti/conf/machine/beaglebone.conf
```bitbake
#@TYPE: Machine
#@NAME: BeagleBone machine
#@DESCRIPTION: Machine configuration for the http://beagleboard.org/bone board

require conf/machine/include/ti33x.inc

# Only has DVI connector for external screen
GUI_MACHINE_CLASS = "bigscreen"

IMAGE_FSTYPES += "tar.bz2"

SERIAL_CONSOLE = "115200 ttyO0"

UBOOT_MACHINE = "am335x_evm_config"

#else we get zImage
KERNEL_IMAGETYPE = "zImage"

SPL_BINARY="MLO"
SPL_UART_BINARY="u-boot-spl.bin"

MACHINE_FEATURES = "usbgadget usbhost"
```
